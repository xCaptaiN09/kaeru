## configs/realme/RMX3031_defconfig
```kconfig
CONFIG_APP_CALLER=0x4822D2E8
CONFIG_BOOTLOADER_BASE=0x48200000
CONFIG_BOOTLOADER_SIZE=0x16B514
CONFIG_DPRINTF_ADDRESS=0x4824925C
CONFIG_FASTBOOT_FAIL_ADDRESS=0x4823138C
CONFIG_FASTBOOT_INFO_ADDRESS=0x4823130C
CONFIG_FASTBOOT_OKAY_ADDRESS=0x48231558
CONFIG_FASTBOOT_PUBLISH_ADDRESS=0x48230EB8
CONFIG_FASTBOOT_REGISTER_ADDRESS=0x48230E7C
CONFIG_FREE_ADDRESS=0x4824968C
CONFIG_LK_LOG_STORE_ADDRESS=0x4825D808
CONFIG_MALLOC_ADDRESS=0x482204A8
CONFIG_MEDIATEK_MT6893=y
CONFIG_MTK_DETECT_KEY_ADDRESS=0x48205C18
CONFIG_PARTITION_READ_ADDRESS=0x48265E24
CONFIG_PLATFORM_INIT_ADDRESS=0x482039B0
CONFIG_REALME_RMX3031=y
CONFIG_THREAD_CREATE_ADDRESS=0x4822C400
CONFIG_THREAD_RESUME_ADDRESS=0x4822C614
CONFIG_VIDEO_PRINTF_ADDRESS=0x48248BF4

CONFIG_BOOTMODE_ADDRESS=0x4836b136
CONFIG_PLATFORM_INIT_CALLER=0x4822bc44
CONFIG_APP_ADDRESS=0x0
```

## configs/tecno/LE7_defconfig
```kconfig
CONFIG_APP_CALLER=0x4C423B20
CONFIG_BOOTLOADER_BASE=0x4C400000
CONFIG_BOOTLOADER_SIZE=0xF8858
CONFIG_DPRINTF_ADDRESS=0x4C432B28
CONFIG_FASTBOOT_INFO_ADDRESS=0x4C426E68
CONFIG_FASTBOOT_PUBLISH_ADDRESS=0x4C426AF4
CONFIG_FASTBOOT_REGISTER_ADDRESS=0x4C426AB8
CONFIG_FREE_ADDRESS=0x4C432F58
CONFIG_INIT_STORAGE_CALLER=0x4C40293E
CONFIG_LK_LOG_STORE_ADDRESS=0x4C446084
CONFIG_MALLOC_ADDRESS=0x4C433824
CONFIG_PLATFORM_INIT_ADDRESS=0x4C402910
CONFIG_THREAD_CREATE_ADDRESS=0x4C422C38
CONFIG_THREAD_RESUME_ADDRESS=0x4C422E4C
CONFIG_VIDEO_PRINTF_ADDRESS=0x4C432708

CONFIG_BOOTMODE_ADDRESS=0x0
CONFIG_PLATFORM_INIT_CALLER=0x0
CONFIG_APP_ADDRESS=0x0
CONFIG_FASTBOOT_FAIL_ADDRESS=0x0
CONFIG_FASTBOOT_OKAY_ADDRESS=0x0
CONFIG_MEDIATEK_MT6769=y
CONFIG_TECNO_LE7=y

CONFIG_MTK_DETECT_KEY_ADDRESS=0x4C405C18
```
